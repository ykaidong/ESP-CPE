## components/iot_usbh_cdc/Kconfig
```kconfig
menu "IoT USB Host CDC"

    config USBH_TASK_CORE_ID
        int "usbh CDC task core_id"
        default 0
        range -1 1
        help
            usb host CDC task to specified core

    config USBH_TASK_BASE_PRIORITY
        int "usbh CDC task base priority"
        default 5
        help
            usb host CDC task base priority

    config USBH_CDC_CONTROL_TRANSFER_BUFFER_SIZE
        int "usbh CDC control transfer size"
        default 256
        help
            usb host CDC control transfer buffer size

    config USBH_CDC_IN_EP_RETRY_COUNT
        int "usbh CDC IN EP retry count"
        default 3
        range 1 100
        help
            Number of consecutive IN/notification transfer retries per CDC port before the
            polling of that port is stopped. When the retry budget is exhausted the port status
            becomes USBH_CDC_PORT_STATUS_ERROR (see usbh_cdc_port_get_status()), and
            usbh_cdc_port_start_data() can be used to restart the polling.
endmenu
```

## components/web_console/Kconfig.projbuild
```kconfig
menu "CPE Web Console"

    config CPE_WEB_MOUNT_POINT
        string "Website mount point in VFS"
        default "/spiffs"
        help
            Specify the mount point in VFS.

    config CPE_WEB_HTTP_LOG
        bool "Log every HTTP request (method, URI, client IP, duration, free heap)"
        default n
        help
            Print one line when a request enters a handler and one line when it
            returns, with the client address, the time the handler took and the
            free heap after the response.

            Useful to tell "the request never reached the device" (Wi-Fi/ARP
            problem) apart from "the device was busy" (httpd blocked) and from
            "the handler is slow"; the free-heap value shows which request
            consumes memory. Keep it off in normal operation: the status page
            polls every few seconds and each poll produces two lines.

endmenu
```

## components/web_wifi/Kconfig.projbuild
```kconfig
menu "4G Modem WiFi Config"

    config SERVER_IP
        string "WiFi AP IP Address"
        default "192.168.4.1"
        help
            IPv4 address assigned to the SoftAP interface. The SoftAP SSID,
            password, channel, bandwidth and maximum station count are
            generated/validated at runtime by components/cpe_core (see the
            "CPE Core Configuration" menu); no fixed credential is compiled in.

    config ESP_MAXIMUM_RETRY
        int "Maximum station reconnect attempts"
        default 5
        range 1 20
        help
            Only used when an optional upstream STA SSID is configured through
            cpe_config. The product WAN is the USB ECM link.

    config EXAMPLE_WEB_MOUNT_POINT
        string "Website mount point in VFS"
        default "/spiffs"
        help
            Specify the mount point in VFS.

endmenu
```

## main/Kconfig.projbuild
```kconfig
menu "CPE Application Configuration"

    config CPE_ENUM_FILTER_ENABLE
        bool "Force the USB configuration value of a specific modem (advanced)"
        default n
        depends on USB_HOST_ENABLE_ENUM_FILTER_CALLBACK
        help
            Selects the USB configuration (bConfigurationValue) of the modem
            identified by the VID/PID below. The official example forced *every*
            multi configuration device to configuration 2, which breaks generic
            ECM modules; this one only touches the configured device.

            Despite the historical name this is a configuration selector, not a
            filter: devices that do not match are still enumerated with their
            own default configuration, the callback only accepts them without
            changing anything. Keep this disabled unless a specific module
            requires it. Requires the local iot_usbh_cdc fork with
            enum_filter_cb support.

            This option additionally depends on
            "USB Host -> Enable enumeration filter callback" (usb component
            Kconfig, CONFIG_USB_HOST_ENABLE_ENUM_FILTER_CALLBACK); enable that
            generic hook first if a specific module needs the filter.

    if CPE_ENUM_FILTER_ENABLE
        config CPE_ECM_VID
            hex "Target device VID (0 = any)"
            default 0x0
            help
                Vendor ID of the device whose configuration is forced. 0 matches
                any. Non-matching devices are still enumerated as usual.

        config CPE_ECM_PID
            hex "Target device PID (0 = any)"
            default 0x0
            help
                Product ID of the device whose configuration is forced. 0 matches
                any. Non-matching devices are still enumerated as usual.

        config CPE_ECM_CONFIG_VALUE
            int "Forced USB configuration value"
            default 1
            range 1 8
            help
                USB bConfigurationValue to select for the matched device. Left
                untouched for every other device.
    endif

    config CPE_MAX_RECOVERY_ATTEMPTS
        int "ECM soft-recovery attempts before escalating"
        default 3
        range 1 10

    config CPE_RECOVERY_RETRY_MS
        int "Delay between recovery attempts (ms)"
        default 60000
        range 5000 600000

    config CPE_OTA_VALIDATE_DELAY_MS
        int "Delay before validating a newly flashed OTA image (ms)"
        default 60000
        range 5000 600000
        help
            With BOOTLOADER_APP_ROLLBACK_ENABLE the image installed by OTA boots
            in PENDING_VERIFY and must be marked valid, otherwise the bootloader
            rolls back on the next reset. The running image is validated after
            this delay: long enough to catch a crash/reboot loop, short enough
            that a healthy device is not rolled back. Reachability of the
            management console (AP/Web) counts as healthy; the 4G link is not
            required, because it depends on the external modem and the network.

    config CPE_USB_PORT_POWER_OFF_MS
        int "USB root port power-off time during recovery (ms)"
        default 1000
        range 100 5000
        help
            When no module RESET GPIO is wired, the USB host root port is
            powered down for this long to detach the modem from the bus (which
            usually makes it reset its USB device controller), then powered back
            up to force a clean enumeration. Longer values are safer for
            externally powered modems; shorter values recover faster.

    config CPE_MODULE_RESET_GPIO
        int "4G module RESET GPIO number (-1 = not connected)"
        default -1
        range -1 48
        help
            When the 4G module is powered independently from the ESP32 (its
            USB VBUS does not drop when the ESP32 resets), the module USB
            stack may stay in a stale state and enumeration fails with
            "CHECK_SHORT_DEV_DESC FAILED". Connect the module RESET_N pin to a
            free GPIO and set it here: the firmware will pulse the module
            reset at boot and during USB enumeration recovery, which makes the
            module enumerate from a clean state. Set to -1 when the pin is not
            wired (default).

    config CPE_MODULE_RESET_ACTIVE_LEVEL
        depends on CPE_MODULE_RESET_GPIO >= 0
        int "Module RESET active level (0 = active low, 1 = active high)"
        default 0
        range 0 1

    config CPE_MODULE_RESET_HOLD_MS
        depends on CPE_MODULE_RESET_GPIO >= 0
        int "Module RESET pulse width (ms)"
        default 200
        range 50 2000

    config CPE_MODULE_BOOT_DELAY_MS
        depends on CPE_MODULE_RESET_GPIO >= 0
        int "Delay after releasing the module reset before USB enumeration (ms)"
        default 1500
        range 200 10000
        help
            Give the module time to boot its USB stack after the reset pulse
            is released.

    config CPE_USB_ENUM_RESET_ATTEMPTS
        int "USB modem reset attempts before giving up"
        default 3
        range 0 10
        help
            How many recovery attempts are made when no USB device is
            enumerated. Each attempt pulses the module reset GPIO when
            configured, otherwise it power-cycles the USB host root port to
            detach the modem from the bus and force a fresh enumeration. The USB
            Host stack is never uninstalled at runtime. Set to 0 to disable this
            recovery entirely.

    config CPE_RESET_BUTTON_GPIO
        int "Reset/factory-reset button GPIO (-1 = disabled)"
        default 0
        range -1 48
        help
            Button wired from the GPIO to GND (active low by default).

            Within CPE_CREDENTIAL_PRINT_WINDOW_MS after boot, double-click the
            button to print the SoftAP and administrator credentials on the
            UART. The AP password is always printable; the admin password is
            printable while it still equals the AP password (a changed admin
            password is stored as a hash only and is reported as changed).
            This is a physical action, so the credentials are only exposed to
            someone holding the device.

            Keep holding it for CPE_FACTORY_RESET_HOLD_MS after boot to restore
            factory settings and reboot.

            NOTE: GPIO0 is the ESP32-S3 boot strapping pin. Holding it low
            while the chip resets selects the UART download mode and the
            application never starts, which is why a double-click (not a
            boot-time hold) is used. Use a different free GPIO if the board
            allows it.

    config CPE_RESET_BUTTON_ACTIVE_LEVEL
        depends on CPE_RESET_BUTTON_GPIO >= 0
        int "Reset button active level (0 = active low, 1 = active high)"
        default 0
        range 0 1

    config CPE_CREDENTIAL_PRINT_WINDOW_MS
        depends on CPE_RESET_BUTTON_GPIO >= 0
        int "Window after boot for the credential-print double-click (ms)"
        default 10000
        range 1000 60000
        help
            A double-click on the reset button within this time after boot
            prints the SoftAP/admin credentials, but only while the admin
            password has never been changed.

    config CPE_DOUBLE_CLICK_MS
        depends on CPE_RESET_BUTTON_GPIO >= 0
        int "Maximum gap between the two clicks (ms)"
        default 800
        range 200 2000
        help
            Maximum time between the start of the first click and the start of
            the second click for the press to count as a double-click.

    config CPE_FACTORY_RESET_HOLD_MS
        depends on CPE_RESET_BUTTON_GPIO >= 0
        int "Hold time to restore factory settings (ms)"
        default 10000
        range 1000 60000
        help
            Continuous hold time after boot before the device restores factory
            settings and reboots.

    config CPE_STATUS_LED_GPIO
        int "WS2812 status LED GPIO (-1 = disabled)"
        default 48
        range -1 48
        help
            Single addressable RGB LED (WS2812/NeoPixel) driven from the RMT
            peripheral. It shows the WAN state:

              red blinking  - no 4G link (modem missing or not enumerated)
              red solid     - link up but no IP yet (no SIM, PDP not active)
              green solid   - link up and an IP was acquired
              blue blinking - factory reset was triggered, reboot pending

            Set to -1 on boards without the LED or when the pin is used for
            something else.

    config CPE_STATUS_LED_BRIGHTNESS
        depends on CPE_STATUS_LED_GPIO >= 0
        int "Status LED brightness per channel (0-255)"
        default 32
        range 1 255
        help
            Scales every colour channel. The default keeps the LED readable
            indoors without being blinding.

    config CPE_STATUS_LED_BLINK_MS
        depends on CPE_STATUS_LED_GPIO >= 0
        int "Status LED blink half-period (ms)"
        default 500
        range 100 2000
        help
            Time the blinking patterns stay on and off. 500 ms gives a calm
            1 Hz blink.

endmenu
```
