## components/app_wifi/Kconfig.projbuild
```kconfig
menu "CPE SoftAP"

    config CPE_WIFI_COUNTRY_CODE
        string "Wi-Fi country code"
        default "CN"
        help
            ISO/IEC 3166-1 alpha-2 code passed to esp_wifi_set_country_code(),
            e.g. "CN", "US", "JP". Espressif's default "01" (world safe) only
            allows 2.4 GHz channels 1-11, so channels 12 and 13 require a
            country code that permits them. Supported codes are listed in
            esp_wifi.h.

    config SERVER_IP
        string "WiFi AP IP Address"
        default "192.168.4.1"
        help
            IPv4 address assigned to the SoftAP interface. The SoftAP SSID,
            password, channel, bandwidth and maximum station count are
            generated/validated at runtime by components/cpe_core (see the
            "CPE Core Configuration" menu); no fixed credential is compiled in.

endmenu
```

## components/cpe_at/Kconfig.projbuild
```kconfig
menu "CPE AT Telemetry Configuration"

    config CPE_AT_ENABLE
        bool "Enable AT telemetry (and modem reset before deliberate restarts)"
        default y
        help
            Open a second CDC port on the modem AT interface (vendor specific
            or CDC-ACM) and poll AT+CSQ / AT+COPS? / AT+CEREG? / AT+CGATT? /
            AT+CGACT? / AT+QCSQ / AT+QTEMP together with ATI / AT+CGSN once.
            The values are shown on the Web status page. Telemetry uses only
            read-only commands, so the data connection is not disturbed.
            The single state-changing command is AT+CFUN=1,1: before every
            deliberate restart (Web reboot, factory reset, OTA, reset button,
            controlled reboot) the modem is asked to reset so it re-enumerates
            cleanly after the ESP boots. This is best effort and bounded; a
            missing AT port never delays the restart.
            QCSQ and QTEMP are Quectel extensions: other modems simply answer
            ERROR and the corresponding rows stay "unknown". Disable this when
            the modem does not expose a usable AT interface next to the ECM
            one.

    config CPE_AT_POLL_INTERVAL_S
        depends on CPE_AT_ENABLE
        int "AT telemetry poll interval (seconds)"
        default 5
        range 5 600
        help
            How often signal strength, carrier and registration state are
            refreshed. The modem identity (model, firmware, IMEI) is read once
            when the AT port is opened.

    config CPE_AT_MODEM_RESET_TIMEOUT_MS
        depends on CPE_AT_ENABLE
        int "Modem reset wait before restart (ms)"
        default 3000
        range 1000 10000
        help
            How long a deliberate restart waits for the AT task to finish
            AT+CFUN=1,1. The wait is bounded on purpose: a wedged AT port must
            never delay the restart. 3000 ms covers one 2 s AT command plus the
            task wake-up and schedule jitter. Raise it only if a slow modem
            regularly answers FWKCHANG/OK later than that.

endmenu
```

## components/cpe_core/Kconfig.projbuild
```kconfig
menu "CPE Core Configuration"

    config CPE_AP_SSID_PREFIX
        string "Default SoftAP SSID prefix"
        default "ESP-CPE"
        help
            The default SoftAP SSID is "<prefix>-XXXX" where XXXX are the last
            two bytes of the device MAC address.

    config CPE_AP_CHANNEL_DEFAULT
        int "Default SoftAP channel"
        default 6
        range 1 13

    config CPE_MAX_STA_DEFAULT
        int "Default maximal STA connections"
        default 8
        range 1 10

    config CPE_ADMIN_USERNAME
        string "Default administrator user name"
        default "admin"

    config CPE_DEVICE_NAME
        string "Default device name"
        default "ESP-CPE"

endmenu
```

## components/cpe_maintenance/Kconfig.projbuild
```kconfig
menu "CPE Maintenance Configuration"

    config CPE_MAX_REBOOTS
        int "Maximum consecutive controlled reboots before staying in fault mode"
        default 3
        range 0 10
        help
            The boot counter is persisted in NVS and cleared after the device
            has been online for CPE_HEALTHY_CLEAR_SECONDS, so a panic loop can
            never restart forever. 0 disables controlled reboots.

    config CPE_HEALTHY_CLEAR_SECONDS
        int "Uptime required to clear the boot counter (seconds)"
        default 120
        range 10 3600

    config CPE_MAINT_ECM_PERIOD_MIN
        int "Periodic ECM interface rebuild (minutes, 0 = disabled)"
        default 0
        range 0 43200
        help
            Every N minutes the ECM network interface is torn down and rebuilt
            WITHOUT rebooting the ESP32: the SoftAP and the web console stay
            up, the modem is not reset, only the WAN interface is recreated.
            The WAN is unavailable for a few seconds while the DHCP client
            obtains a new lease.

            This clears driver/lwIP/modem-session state that slowly degrades
            over long runs and is the cheapest way to recover a WAN path that
            is "up but not passing traffic". The action is skipped while an
            OTA upload or an unvalidated OTA image is pending and the request
            is executed by the link manager task, never concurrently with its
            own recovery actions.

            This Kconfig value is only the DEFAULT (first boot / factory
            reset): the active value is stored in NVS and can be changed at
            runtime from the management console (/api/system/maintenance).

            0 disables the periodic rebuild.

    config CPE_MAINT_REBOOT_PERIOD_MIN
        int "Periodic device reboot (minutes, 0 = disabled)"
        default 0
        range 0 43200
        help
            Every N minutes the ESP32 reboots after the standard pre-restart
            cleanup (AT+CFUN=1,1 when the AT port is available, then Wi-Fi
            deauthentication). This is the last-resort cure for a firmware or
            modem state that a soft recovery cannot fix. All SoftAP clients
            are disconnected and the 4G link is down for tens of seconds.

            A scheduled reboot is skipped while an OTA upload/image validation
            is in progress and it is counted by a dedicated NVS guard
            (CPE_MAINT_MAX_SCHED_REBOOTS): after that many consecutive
            scheduled reboots that never reached a steady state (the link
            manager left the boot phase) the timer stops rebooting and only
            reports the fault, so a firmware that cannot come back up is not
            rebooted forever. A missing SIM/modem does not count as unhealthy,
            only a device that keeps failing to boot does.

            This Kconfig value is only the DEFAULT (first boot / factory
            reset): the active value is stored in NVS and can be changed at
            runtime from the management console (/api/system/maintenance).

            0 disables the periodic reboot.

    config CPE_MAINT_RESET_MODEM
        bool "Reset the 4G module before a scheduled reboot"
        default y
        help
            Send AT+CFUN=1,1 (best effort, bounded to
            CPE_AT_MODEM_RESET_TIMEOUT_MS) before the scheduled reboot so the
            modem re-enumerates cleanly afterwards. Only applies to the
            scheduled reboot: the periodic ECM rebuild never resets the modem.
            Disable this when the modem drops off the bus during its own reset
            and needs a physical replug.

    config CPE_MAINT_MAX_SCHED_REBOOTS
        int "Consecutive scheduled reboots without a healthy period"
        default 3
        range 1 20
        help
            The count is persisted in NVS and cleared once the device has been
            in a steady state for CPE_HEALTHY_CLEAR_SECONDS ("steady" = the
            link manager left the boot phase, the 4G link itself is not
            required). When the limit is reached the scheduled reboot is frozen
            (and reported in the status error text) instead of rebooting a
            device that cannot boot.

endmenu
```

## components/cpe_sms/Kconfig.projbuild
```kconfig
menu "CPE SMS Configuration"

    config CPE_SMS_ENABLE
        bool "Enable SMS over the modem AT interface"
        default n
        help
            Adds a management-console page to list/send/delete SMS messages
            using the modem AT interface. Requires AT telemetry (CPE_AT_ENABLE)
            and a modem that exposes a usable AT port and supports PDU-mode
            reception (AT+CMGF=0, AT+CMGL=4) plus text-mode sending
            (AT+CMGF=1, AT+CMGS). Capability is probed at runtime; on a modem
            without SMS support the page reports "unsupported" and the 4G data
            path is unaffected. Sending is rate limited and requires a valid
            admin session. Disabled by default.

endmenu
```

## components/cpe_sms_mqtt/Kconfig.projbuild
```kconfig
menu "CPE SMS Forwarding Configuration"

    config CPE_SMS_MQTT_ENABLE
        bool "Forward SMS to an MQTT broker over TLS"
        depends on CPE_SMS_ENABLE
        default y
        help
            Adds a forwarding panel to the SMS page: received messages are
            published to the broker configured there, and downlink send
            commands are executed when that switch is on. Such a command may
            address any number, so the broker ACL is the only restriction on
            who is allowed to publish one. The connection is
            TLS only (mqtts://), verified against the built-in public CA
            bundle, or against a CA certificate uploaded from the panel when
            one is installed. Runs only while the WAN link is online, and an
            unreachable broker never blocks the data path.

endmenu
```

## components/cpe_wan/Kconfig.projbuild
```kconfig
menu "CPE WAN Configuration"

    config CPE_USB_TASK_STACK_SIZE
        int "USB client task stack size"
        default 4096
        range 2048 16384

    config CPE_USB_TASK_PRIORITY
        int "USB client task priority"
        default 10
        range 5 23
        help
            Keep this below the lwIP/Wi-Fi task priorities (18 by default).
            The official example used configMAX_PRIORITIES-1 (24), which could
            starve the network stack.

    config CPE_USB_TASK_CORE_ID
        int "USB task core id (-1 = no affinity)"
        default -1

    config CPE_LINK_TIMEOUT_MS
        int "Timeout waiting for the USB 4G link (ms)"
        default 30000
        range 1000 600000
        help
            If no USB link is reported within this time the link manager
            rebuilds the ECM driver and eventually power-cycles the root port.

    config CPE_IP_TIMEOUT_MS
        int "Timeout waiting for an IP address after link up (ms)"
        default 30000
        range 10000 300000
        help
            How long the link manager waits for an IP after the 4G link comes
            up before it starts the recovery ladder (DHCP restarts, ECM
            rebuilds, module restart). The module runs the DHCP server on the
            local ECM link, so a healthy modem answers within seconds: field
            logs show an address about 4 s after link up, including right after
            a module restart. 30 s leaves several times that margin while
            keeping the recovery short; raise it if a modem is known to answer
            more slowly. The AP/Web console stays reachable either way.

    config CPE_PDP_WAIT_MS
        int "Time an inactive PDP context is tolerated before the modem is restarted (ms)"
        default 60000
        range 0 600000
        help
            The 4G module runs its own DHCP server on the ECM interface and
            answers it even with no SIM card inserted, so an IP address alone
            does not prove that traffic can flow: what carries the data is the
            PDP context, reported by the AT telemetry (AT+CGACT?). With this
            option the CPE only counts as ONLINE while that context is active,
            and restarts the module when it stays inactive for this long
            (bounded by CPE_IP_MODEM_RESETS, the same budget as the "no IP"
            ladder). The state has to persist for the whole window: a single
            poll reporting the context down while the modem is attaching is not
            a reason to restart it. An unknown PDP state - AT telemetry
            disabled, a modem that does not answer the command, or the first
            seconds before the first poll - counts as usable, so the CPE still
            comes online without AT. 0 disables the check: an IP is enough,
            the behaviour before this option existed.

    config CPE_IP_DHCP_RESTARTS
        int "DHCP-client restarts before rebuilding the ECM driver"
        default 1
        range 0 10
        help
            When the link is up but no IP arrives, keep the ECM/USB session
            alive and only restart the DHCP client this many times first. Each
            attempt costs a full CPE_IP_TIMEOUT_MS, and a modem-side DHCP hang
            (the case seen in the field) is not fixed by it, so one restart is
            enough to clear a wedged client before the driver is rebuilt.
            0 keeps the old behaviour (rebuild ECM on the first timeout).

    config CPE_IP_MAX_ECM_REBUILDS
        int "ECM rebuilds before a modem restart or DHCP-only recovery"
        default 1
        range 0 20
        help
            Bounds the expensive step of the recovery: every ECM rebuild resets
            the modem USB interface, and repeating it never helps when the real
            cause is a modem-side DHCP hang, a missing SIM or an inactive PDP
            context. After this many rebuilds the ladder escalates to restarting
            the module itself (CPE_IP_MODEM_RESETS); once that budget is used up
            it degrades to DHCP retries only, so a SIM (or a PDP context) that
            shows up later is still picked up while the SoftAP/Web console stays
            available. One rebuild is enough to recover a stale driver or netif
            on the ESP side without spending minutes before the module restart.
            The counter is reset when an IP is acquired, when the CPE reaches
            ONLINE and by a scheduled rebuild; it deliberately survives the link
            drop that a rebuild itself causes, otherwise every rebuild would
            start with a fresh budget. 0 keeps the old behaviour (rebuild ECM on
            every timeout, unbounded).

    config CPE_IP_MODEM_RESETS
        int "Modem restarts when the link is up but no IP arrives"
        default 2
        range 0 5
        help
            Last step of the "link up but no IP" ladder, tried only after the
            DHCP-client restarts AND the ECM rebuilds above are both exhausted:
            restarting the 4G module itself (AT+CFUN=1,1). Field observation:
            a modem that keeps its ECM session but never answers DHCP comes back
            with an address after a module restart, while rebuilding the ECM
            driver alone does not. The module drops off the USB bus, so the ECM
            interface is torn down and recreated; the ladder then starts over
            (DHCP -> ECM rebuild -> another module restart) until this budget is
            used up, after which recovery degrades to DHCP retries only. The
            counter is reset when an IP is acquired, when the CPE reaches ONLINE
            and by a scheduled rebuild. Requires AT telemetry
            (CONFIG_CPE_AT_ENABLE): without it the step is skipped and DHCP
            retries continue. 0 disables the step.

endmenu
```
